## main/Kconfig.projbuild
```kconfig
menu "Project Configuration"

    choice I2S_NUM
        prompt "I2S number"
        default I2S_NUM_0
        help
            Defines the I2S port for microphone data input.

        config I2S_NUM_0
            bool "I2S 0"
        config I2S_NUM_1
            bool "I2S 1"
    endchoice

    config I2S_DATA_GPIO
        int "I2S Data GPIO number"
        default 2
        help
            Set the GPIO number used for transmitting/receiving data from I2S.

    config I2S_WS_GPIO
        int "I2S Word select GPIO number"
        default 42
        help
            Set the GPIO number used for the word select line from I2S.

    config I2S_CLK_GPIO
        int "I2S Clock GPIO number"
        default 41
        help
            Set the GPIO number used for the clock line from I2S.

    config LED_GPIO
        int "Led GPIO number"
        range 0 48
        default 3
        help
            GPIO number to turn LED on and off by predicted command.

    config SDIO_CMD_GPIO
        int "SD card CMD GPIO number"
        default 38
        help
            Set the GPIO number used for CMD from SDIO.

    config SDIO_CLK_GPIO
        int "SD card CLK GPIO number"
        default 39
        help
            Set the GPIO number used for CLK from SDIO.

    config SDIO_D0_GPIO
        int "SD card D0 GPIO number"
        default 40
        help
            Set the GPIO number used for D0 from SDIO.

endmenu
```
